## driver/Kconfig
```kconfig
menu "Hardware Drivers Config"

config SOC_LPC1114
    bool
    select SOC_LPC1114_SERIES
    select RT_USING_COMPONENTS_INIT
    select RT_USING_USER_MAIN
    default y

menu "On-chip Peripheral Drivers"

    menuconfig BSP_USING_GPIO
        bool "Enable GPIO"
        select RT_USING_GPIO
        default y
        if BSP_USING_GPIO
            config BSP_USING_GPIO_LED
            bool "Enable GPIO_LED"
            default y
            config BSP_USING_GPIO_KEY
            bool "Enable GPIO_KEY"
            default y
        endif

    menuconfig BSP_USING_SERIAL
        select RT_USING_SERIAL
        bool "Enable UART"
        default n
        
endmenu

menu "Onboard Peripheral Drivers"

endmenu

menu "Board extended module Drivers"

endmenu

endmenu
```
